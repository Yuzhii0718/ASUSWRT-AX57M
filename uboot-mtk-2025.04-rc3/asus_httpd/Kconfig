## uboot-mtk-2025.04-rc3/asus_httpd/Kconfig
```kconfig
#
# ASUS Web UI
#

config ASUS_WEBUI
	bool "Enable ASUS Web UI"
	select MTK_TCP
	select MTK_HTTPD
	default n
	help
	  Enable Web based ASUS rescue UI
```

## uboot-mtk-2025.04-rc3/failsafe/Kconfig
```kconfig
#
# Failsafe Web UI
#

config WEBUI_FAILSAFE
	bool "Enable Failsafe Web UI"
	select MTK_TCP
	select MTK_HTTPD
	depends on !ASUS_WEBUI
	default n
	help
	  Enable Web based failsafe UI
```
